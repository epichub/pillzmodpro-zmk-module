## boards/shields/pillzmodpro/Kconfig.defconfig
```kconfig
# Copyright (c) 2020 The ZMK Contributors
# SPDX-License-Identifier: MIT

if SHIELD_PILLZMODPRO
# debug output to check if this is set correctly

config ZMK_KEYBOARD_NAME
    default "pillzmodpro"

config SPI
    default y

endif
```

## boards/shields/pillzmodpro/Kconfig.shield
```kconfig
# Copyright (c) 2020 The ZMK Contributors
# SPDX-License-Identifier: MIT

config SHIELD_PILLZMODPRO
    def_bool $(shields_list_contains,pillzmodpro)
    
```
